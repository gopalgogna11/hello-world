# processor: IP-XACT component
VLNV spiritconsortium.org:Leon2RTL:processor:1.2
32-bit CPU microprocessor core, based on the SPARC-V8 RISC architecture and instruction set

## Parameters
local_memory_start_addr = ($start_addr_local ) / 65536 — example to show, how to write parameteres.
local_memory_addr_bits = log($range_local +1)

## Bus interfaces (logical=physical port)
AHBClk: slave spiritconsortium.org: busdef.clock: clock_rtl: 1.0
  CLK=hclk
AHBReset: slave spiritconsortium.org: busdef.reset: reset_rtl: 1.0
  RESETn=hresetn
AHBmaster: slave amba.com:AMBA2:AHB_rtl:r2p0_6
  HRDATA=hrdata, HGRANTx=hgrant, HADDR=haddr, HTRANS=htrans, HWRITE=hwrite, HSIZE=hsize, HBURST=hburst, HPROT=hprot, HWDATA=hwdata, HBUSREQx=hbusreq, HREADY=hready, HRESP=hresp, HCLK=hclk, HRESETn=hresetn
APBslave: slave amba.com:AMBA2:APB_rtl:r2p0_4
  PADDR=paddr, PRDATA=prdata, PWRITE=pwrite, PSELx=psel, PENABLE=penable, PCLK=pclk, PRESETn=presetn
SlaveIntController: slave spiritconsortium.org:busdef.leon2:IntProc_rtl:v1.0
  IRL=irl, IRQVEC=irqvec, INTack=intack
JTAG: slave spiritconsortium.org:busdef.jtag:jtag_rtl:1.0
  TCK=tck, NTRST=ntrst, TMS=tms, TDI=tdi, TDO=tdo

## Ports
in rst_an
in clk
in clkn
in pclk
in presetn
in psel
in penable
in paddr[11:0]
in pwrite
in pwdata[31:0]
out prdata[31:0]
in hclk
in hresetn
in hgrant
in hready
in hresp[1:0]
in hrdata[31:0]
out hbusreq
out htrans[1:0out]
out haddr[31:0]
out hwrite — {default=0x0}
out hsize[2:0]
out hburst[2:0]
out hprot[3:0]
out hwdata[31:0]
in irl[3:0]
out intack
out irqvec[3:0]
in tck
in ntrst
in tms
in tdi
out tdo
out SimDone

## Address spaces and blocks
ambaAPB.registers: base 0x00, range 0x20, width 32

## Registers
Registers are 32-bit, read-write, reset 0x0 unless marked. A register's access mark holds for its fields unless they carry their own. Offsets are from the block's base; lines under a group give offsets from that group; [hi:lo] are bit positions; {n}, {i} and the like mark numbered series; 'fields as' and 'values as' point back to an identical list; <NAME> marks a mode.

## ambaAPB.registers
Base 0x00000000
0x00 Failures ro
  [31:0] NumFailures — Number of failures from the AHB BFM
0x04 lowest1k
  [31:0] lowest1
0x08 midlow1k
  [31:0] midlow1
0x0C midhigh1k
0x10 highest1kx7_0
  [31:0] highest7
0x14 highest1kx15_8
  [31:0] highest1
0x18 highest1kx23_16
  [31:0] highest12
0x1C highest1kx31_24
  [31:0] highest31
